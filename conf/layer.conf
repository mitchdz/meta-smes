## conf/layer.conf
```bitbake
# We have a conf and classes directory, add to BBPATH
BBPATH .= ":${LAYERDIR}"

# We have recipes-* directories, add to BBFILES
BBFILES += "${LAYERDIR}/recipes-*/*/*.bb \
            ${LAYERDIR}/recipes-*/*.b \
            ${LAYERDIR}/recipes-*/*/*.bbappend"

BBFILE_COLLECTIONS += "meta-smes"
BBFILE_PATTERN_meta-smes = "^${LAYERDIR}/"
BBFILE_PRIORITY_meta-smes = "6"

LAYERDEPENDS_meta-smes = "core"
LAYERSERIES_COMPAT_meta-smes = "zeus gatesgarth"
```
